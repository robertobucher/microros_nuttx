## my_app/Kconfig
```kconfig
config MICROROS_MYAPP
  bool "micro-ROS own app"
  default n
  depends on MICROROSLIB
  ---help---
    Enable the micro-ROS own  app
```

## publisher_app/Kconfig
```kconfig
config MICROROS_PUBLISHER
  bool "micro-ROS publisher app"
  default n
  depends on MICROROSLIB
  ---help---
    Enable the micro-ROS publisher app
```

## pysim_app/Kconfig
```kconfig
config MICROROS_PYSIM
  bool "micro-ROS pysimCoder interface"
  default n
  depends on MICROROSLIB
  ---help---
    Enable the micro-ROS pysimCoder interface
```

## subscriber_app/Kconfig
```kconfig
config MICROROS_SUBSCRIBER
  bool "micro-ROS subscriber app"
  default n
  depends on MICROROSLIB
  ---help---
    Enable the micro-ROS subscriber app
```

## sum_service_app/Kconfig
```kconfig
config MICROROS_SUM_SERVICE
  bool "micro-ROS sum_service app"
  default n
  depends on MICROROSLIB
  ---help---
    Enable the micro-ROS sum_service app
```
